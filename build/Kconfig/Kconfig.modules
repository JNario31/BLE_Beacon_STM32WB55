## build/Kconfig/soc/Kconfig.soc
```kconfig
# Load SoC Kconfig descriptions.
osource "/Users/johnnario/ZephyrProjects/FirstProject/zephyr/soc/xlnx/zynqmp/Kconfig.soc"
osource "/Users/johnnario/ZephyrProjects/FirstProject/zephyr/soc/xlnx/zynq7000/Kconfig.soc"
osource "/Users/johnnario/ZephyrProjects/FirstProject/zephyr/soc/xlnx/versalnet/Kconfig.soc"
osource "/Users/johnnario/ZephyrProjects/FirstProject/zephyr/soc/xlnx/versal2/Kconfig.soc"
osource "/Users/johnnario/ZephyrProjects/FirstProject/zephyr/soc/xlnx/versal/Kconfig.soc"
osource "/Users/johnnario/ZephyrProjects/FirstProject/zephyr/soc/xen/Kconfig.soc"
osource "/Users/johnnario/ZephyrProjects/FirstProject/zephyr/soc/wch/ch32v/Kconfig.soc"
osource "/Users/johnnario/ZephyrProjects/FirstProject/zephyr/soc/ti/simplelink/Kconfig.soc"
osource "/Users/johnnario/ZephyrProjects/FirstProject/zephyr/soc/ti/mspm0/Kconfig.soc"
osource "/Users/johnnario/ZephyrProjects/FirstProject/zephyr/soc/ti/lm3s6965/Kconfig.soc"
osource "/Users/johnnario/ZephyrProjects/FirstProject/zephyr/soc/ti/k3/Kconfig.soc"
osource "/Users/johnnario/ZephyrProjects/FirstProject/zephyr/soc/telink/tlsr/Kconfig.soc"
osource "/Users/johnnario/ZephyrProjects/FirstProject/zephyr/soc/starfive/jh71xx/Kconfig.soc"
osource "/Users/johnnario/ZephyrProjects/FirstProject/zephyr/soc/st/stm32/Kconfig.soc"
osource "/Users/johnnario/ZephyrProjects/FirstProject/zephyr/soc/snps/qemu_arc/Kconfig.soc"
osource "/Users/johnnario/ZephyrProjects/FirstProject/zephyr/soc/snps/nsim/arc_v/Kconfig.soc"
osource "/Users/johnnario/ZephyrProjects/FirstProject/zephyr/soc/snps/nsim/arc_classic/Kconfig.soc"
osource "/Users/johnnario/ZephyrProjects/FirstProject/zephyr/soc/snps/hsdk4xd/Kconfig.soc"
osource "/Users/johnnario/ZephyrProjects/FirstProject/zephyr/soc/snps/hsdk/Kconfig.soc"
osource "/Users/johnnario/ZephyrProjects/FirstProject/zephyr/soc/snps/emsk/Kconfig.soc"
osource "/Users/johnnario/ZephyrProjects/FirstProject/zephyr/soc/snps/emsdp/Kconfig.soc"
osource "/Users/johnnario/ZephyrProjects/FirstProject/zephyr/soc/snps/arc_iot/Kconfig.soc"
osource "/Users/johnnario/ZephyrProjects/FirstProject/zephyr/soc/silabs/Kconfig.soc"
osource "/Users/johnnario/ZephyrProjects/FirstProject/zephyr/soc/sifli/sf32/Kconfig.soc"
osource "/Users/johnnario/ZephyrProjects/FirstProject/zephyr/soc/sifive/sifive_freedom/Kconfig.soc"
osource "/Users/johnnario/ZephyrProjects/FirstProject/zephyr/soc/sensry/Kconfig.soc"
osource "/Users/johnnario/ZephyrProjects/FirstProject/zephyr/soc/rockchip/Kconfig.soc"
osource "/Users/johnnario/ZephyrProjects/FirstProject/zephyr/soc/renode/riscv_virtual/Kconfig.soc"
osource "/Users/johnnario/ZephyrProjects/FirstProject/zephyr/soc/renode/cortex_r8_virtual/Kconfig.soc"
osource "/Users/johnnario/ZephyrProjects/FirstProject/zephyr/soc/renesas/smartbond/Kconfig.soc"
osource "/Users/johnnario/ZephyrProjects/FirstProject/zephyr/soc/renesas/rz/Kconfig.soc"
osource "/Users/johnnario/ZephyrProjects/FirstProject/zephyr/soc/renesas/rx/Kconfig.soc"
osource "/Users/johnnario/ZephyrProjects/FirstProject/zephyr/soc/renesas/rcar/Kconfig.soc"
osource "/Users/johnnario/ZephyrProjects/FirstProject/zephyr/soc/renesas/ra/Kconfig.soc"
osource "/Users/johnnario/ZephyrProjects/FirstProject/zephyr/soc/realtek/ec/Kconfig.soc"
osource "/Users/johnnario/ZephyrProjects/FirstProject/zephyr/soc/raspberrypi/rpi_pico/Kconfig.soc"
osource "/Users/johnnario/ZephyrProjects/FirstProject/zephyr/soc/quicklogic/eos_s3/Kconfig.soc"
osource "/Users/johnnario/ZephyrProjects/FirstProject/zephyr/soc/qemu/virt_riscv/Kconfig.soc"
osource "/Users/johnnario/ZephyrProjects/FirstProject/zephyr/soc/qemu/malta/Kconfig.soc"
osource "/Users/johnnario/ZephyrProjects/FirstProject/zephyr/soc/openisa/rv32m1/Kconfig.soc"
osource "/Users/johnnario/ZephyrProjects/FirstProject/zephyr/soc/openhwgroup/cva6/Kconfig.soc"
osource "/Users/johnnario/ZephyrProjects/FirstProject/zephyr/soc/oct/osd32mp15x/Kconfig.soc"
osource "/Users/johnnario/ZephyrProjects/FirstProject/zephyr/soc/nxp/s32/Kconfig.soc"
osource "/Users/johnnario/ZephyrProjects/FirstProject/zephyr/soc/nxp/rw/Kconfig.soc"
osource "/Users/johnnario/ZephyrProjects/FirstProject/zephyr/soc/nxp/mcx/Kconfig.soc"
osource "/Users/johnnario/ZephyrProjects/FirstProject/zephyr/soc/nxp/lpc/Kconfig.soc"
osource "/Users/johnnario/ZephyrProjects/FirstProject/zephyr/soc/nxp/layerscape/Kconfig.soc"
osource "/Users/johnnario/ZephyrProjects/FirstProject/zephyr/soc/nxp/kinetis/Kconfig.soc"
osource "/Users/johnnario/ZephyrProjects/FirstProject/zephyr/soc/nxp/imxrt/Kconfig.soc"
osource "/Users/johnnario/ZephyrProjects/FirstProject/zephyr/soc/nxp/imx/Kconfig.soc"
osource "/Users/johnnario/ZephyrProjects/FirstProject/zephyr/soc/nuvoton/numicro/Kconfig.soc"
osource "/Users/johnnario/ZephyrProjects/FirstProject/zephyr/soc/nuvoton/numaker/Kconfig.soc"
osource "/Users/johnnario/ZephyrProjects/FirstProject/zephyr/soc/nuvoton/npcx/Kconfig.soc"
osource "/Users/johnnario/ZephyrProjects/FirstProject/zephyr/soc/nuvoton/npcm/Kconfig.soc"
osource "/Users/johnnario/ZephyrProjects/FirstProject/zephyr/soc/nordic/Kconfig.soc"
osource "/Users/johnnario/ZephyrProjects/FirstProject/zephyr/soc/neorv32/Kconfig.soc"
osource "/Users/johnnario/ZephyrProjects/FirstProject/zephyr/soc/native/inf_clock/Kconfig.soc"
osource "/Users/johnnario/ZephyrProjects/FirstProject/zephyr/soc/microchip/sam/sama7/Kconfig.soc"
osource "/Users/johnnario/ZephyrProjects/FirstProject/zephyr/soc/microchip/sam/sam_d5x_e5x/Kconfig.soc"
osource "/Users/johnnario/ZephyrProjects/FirstProject/zephyr/soc/microchip/pic32c/pic32cz_ca/Kconfig.soc"
osource "/Users/johnnario/ZephyrProjects/FirstProject/zephyr/soc/microchip/pic32c/pic32cx_sg/Kconfig.soc"
osource "/Users/johnnario/ZephyrProjects/FirstProject/zephyr/soc/microchip/pic32c/pic32cm_jh/Kconfig.soc"
osource "/Users/johnnario/ZephyrProjects/FirstProject/zephyr/soc/microchip/miv/Kconfig.soc"
osource "/Users/johnnario/ZephyrProjects/FirstProject/zephyr/soc/microchip/mec/Kconfig.soc"
osource "/Users/johnnario/ZephyrProjects/FirstProject/zephyr/soc/mediatek/mt8xxx/Kconfig.soc"
osource "/Users/johnnario/ZephyrProjects/FirstProject/zephyr/soc/lowrisc/opentitan/Kconfig.soc"
osource "/Users/johnnario/ZephyrProjects/FirstProject/zephyr/soc/litex/litex_vexriscv/Kconfig.soc"
osource "/Users/johnnario/ZephyrProjects/FirstProject/zephyr/soc/ite/ec/Kconfig.soc"
osource "/Users/johnnario/ZephyrProjects/FirstProject/zephyr/soc/intel/wildcat_lake/Kconfig.soc"
osource "/Users/johnnario/ZephyrProjects/FirstProject/zephyr/soc/intel/raptor_lake/Kconfig.soc"
osource "/Users/johnnario/ZephyrProjects/FirstProject/zephyr/soc/intel/panther_lake/Kconfig.soc"
osource "/Users/johnnario/ZephyrProjects/FirstProject/zephyr/soc/intel/lakemont/Kconfig.soc"
osource "/Users/johnnario/ZephyrProjects/FirstProject/zephyr/soc/intel/intel_socfpga_std/Kconfig.soc"
osource "/Users/johnnario/ZephyrProjects/FirstProject/zephyr/soc/intel/intel_socfpga/Kconfig.soc"
osource "/Users/johnnario/ZephyrProjects/FirstProject/zephyr/soc/intel/intel_niosv/Kconfig.soc"
osource "/Users/johnnario/ZephyrProjects/FirstProject/zephyr/soc/intel/intel_ish/Kconfig.soc"
osource "/Users/johnnario/ZephyrProjects/FirstProject/zephyr/soc/intel/intel_adsp/Kconfig.soc"
osource "/Users/johnnario/ZephyrProjects/FirstProject/zephyr/soc/intel/elkhart_lake/Kconfig.soc"
osource "/Users/johnnario/ZephyrProjects/FirstProject/zephyr/soc/intel/atom/Kconfig.soc"
osource "/Users/johnnario/ZephyrProjects/FirstProject/zephyr/soc/intel/apollo_lake/Kconfig.soc"
osource "/Users/johnnario/ZephyrProjects/FirstProject/zephyr/soc/intel/alder_lake/Kconfig.soc"
osource "/Users/johnnario/ZephyrProjects/FirstProject/zephyr/soc/infineon/edge/Kconfig.soc"
osource "/Users/johnnario/ZephyrProjects/FirstProject/zephyr/soc/infineon/cat3/Kconfig.soc"
osource "/Users/johnnario/ZephyrProjects/FirstProject/zephyr/soc/infineon/cat1c/Kconfig.soc"
osource "/Users/johnnario/ZephyrProjects/FirstProject/zephyr/soc/infineon/cat1b/Kconfig.soc"
osource "/Users/johnnario/ZephyrProjects/FirstProject/zephyr/soc/infineon/cat1a/Kconfig.soc"
osource "/Users/johnnario/ZephyrProjects/FirstProject/zephyr/soc/gd/gd32/Kconfig.soc"
osource "/Users/johnnario/ZephyrProjects/FirstProject/zephyr/soc/gaisler/leon3/Kconfig.soc"
osource "/Users/johnnario/ZephyrProjects/FirstProject/zephyr/soc/gaisler/gr716a/Kconfig.soc"
osource "/Users/johnnario/ZephyrProjects/FirstProject/zephyr/soc/espressif/Kconfig.soc"
osource "/Users/johnnario/ZephyrProjects/FirstProject/zephyr/soc/ene/kb1200/Kconfig.soc"
osource "/Users/johnnario/ZephyrProjects/FirstProject/zephyr/soc/ene/kb106x/Kconfig.soc"
osource "/Users/johnnario/ZephyrProjects/FirstProject/zephyr/soc/egis/Kconfig.soc"
osource "/Users/johnnario/ZephyrProjects/FirstProject/zephyr/soc/efinix/sapphire/Kconfig.soc"
osource "/Users/johnnario/ZephyrProjects/FirstProject/zephyr/soc/cdns/xtensa_sample_controller/Kconfig.soc"
osource "/Users/johnnario/ZephyrProjects/FirstProject/zephyr/soc/cdns/sample_controller32/Kconfig.soc"
osource "/Users/johnnario/ZephyrProjects/FirstProject/zephyr/soc/cdns/dc233c/Kconfig.soc"
osource "/Users/johnnario/ZephyrProjects/FirstProject/zephyr/soc/brcm/bcmvk/Kconfig.soc"
osource "/Users/johnnario/ZephyrProjects/FirstProject/zephyr/soc/brcm/bcm2712/Kconfig.soc"
osource "/Users/johnnario/ZephyrProjects/FirstProject/zephyr/soc/brcm/bcm2711/Kconfig.soc"
osource "/Users/johnnario/ZephyrProjects/FirstProject/zephyr/soc/bflb/Kconfig.soc"
osource "/Users/johnnario/ZephyrProjects/FirstProject/zephyr/soc/atmel/sam0/Kconfig.soc"
osource "/Users/johnnario/ZephyrProjects/FirstProject/zephyr/soc/atmel/sam/Kconfig.soc"
osource "/Users/johnnario/ZephyrProjects/FirstProject/zephyr/soc/aspeed/Kconfig.soc"
osource "/Users/johnnario/ZephyrProjects/FirstProject/zephyr/soc/arm/Kconfig.soc"
osource "/Users/johnnario/ZephyrProjects/FirstProject/zephyr/soc/arm/beetle/Kconfig.soc"
osource "/Users/johnnario/ZephyrProjects/FirstProject/zephyr/soc/antmicro/myra/Kconfig.soc"
osource "/Users/johnnario/ZephyrProjects/FirstProject/zephyr/soc/andestech/Kconfig.soc"
osource "/Users/johnnario/ZephyrProjects/FirstProject/zephyr/soc/amd/acp_6_0/Kconfig.soc"
osource "/Users/johnnario/ZephyrProjects/FirstProject/zephyr/soc/ambiq/Kconfig.soc"
osource "/Users/johnnario/ZephyrProjects/FirstProject/zephyr/soc/aesc/Kconfig.soc"
osource "/Users/johnnario/ZephyrProjects/FirstProject/zephyr/soc/adi/max32/Kconfig.soc"
```
